/*
 * MARVELL BERLIN2Q4K DMP board device tree source
 *
 * Author:	Jisheng Zhang <jszhang@marvell.com>
 * Copyright (c) 2013 Marvell International Ltd.
 *		http://www.marvell.com
 *
 * This program is free software; you can redistribute it and/or modify
 * it under the terms of the GNU General Public License version 2 as
 * published by the Free Software Foundation.
*/

/dts-v1/;
/include/ "berlin2q.dtsi"

/ {
	model = "MARVELL BG2Q4K DMP board based on BERLIN2Q4K";
	compatible = "marvell,berlin2q4k-dmp", "marvell,berlin2q4k", "marvell,berlin";
	soc {
		usb@F7A30000 {
			status = "disabled";
		};

		sdhci@F7AB0000 {
			marvell,txcfg = <0x80f000b0>;
		};
	};
};
